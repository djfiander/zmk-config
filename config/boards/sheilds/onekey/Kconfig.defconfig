## config/boards/shields/handwired68/Kconfig.defconfig
```kconfig
if SHIELD_HANDWIRED68

config ZMK_KEYBOARD_NAME
       default "Handwired 68"

config ZMK_KSCAN_MATRIX_POLLING
       default y

endif
```

## config/boards/shields/onekey/Kconfig.shield
```kconfig
config SHIELD_ONEKEY
       def_bool $(shields_list_contains, onekey)

if BOARD_ADAFRUIT_FEATHER_NRF52840 || BOARD_BLACKPILL_F411CE

config ZMK_USB
       default y

endif

if BOARD_ADAFRUIT_FEATHER_NRF52840

config ZMK_BLE
       default y

endif
```
