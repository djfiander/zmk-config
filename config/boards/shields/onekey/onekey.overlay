/ {
	chosen {
		zmk,kscan = &kscan0;
  	};
/*
	// Pro-micro compatible
	kscan0: kscan_0 {
		compatible = "zmk,kscan-gpio-matrix","arduino-pro-micro";
		label = "KSCAN";
		diode-direction = "col2row";

		col-gpios
			= <&pro_micro 21 GPIO_ACTIVE_HIGH>
			;

		row-gpios
			= <&pro_micro 10 (GPIO_ACTIVE_HIGH|GPIO_PULL_DOWN)>
			;
	};
*/
	// Feather
	kscan0: kscan_0 {
		compatible = "zmk,kscan-gpio-direct";
		label = "KSCAN";

		input-gpios
			= <&gpio1 2 (GPIO_ACTIVE_HIGH|GPIO_PULL_DOWN) >;
	};
/*
        // Blackpill
	kscan0: kscan_0 {
		compatible = "zmk,kscan-gpio-direct";
		label = "KSCAN";

		input-gpios
			= <&gpioa 0 (GPIO_ACTIVE_LOW | GPIO_PULL_UP)>
			;
	};
*/
};
